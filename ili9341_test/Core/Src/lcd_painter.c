/*
 * lcd_painter.c
 *
 *  Created on: 27 mar 2023
 *      Author: Giacomo
 */

#include "lcd_painter.h"

const uint8_t font_8_12[768] = { 0x0, 0x18, 0x3c, 0x66, 0x66, 0x66, 0x7e, 0x66, 0x66, 0x66, 0x0, 0x0, 0x0,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 0xf8, 0x70 };
const uint8_t font_10_16[1280] = { 0x0, 0x3, 0x1, 0xe0, 0xfc, 0x73, 0x98, 0x67, 0xf9, 0xfe, 0x61, 0x98, 0x66,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 0xe0, };
const uint8_t font_12_18[1728] = { 0x0, 0x0, 0x60, 0xf, 0x1, 0xf8, 0x39, 0xc7, 0xe, 0x60, 0x67, 0xfe, 0x7f,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 0x0, 0x0 };

uint16_t Translate(char c) {
	static uint8_t map[256];
	static uint8_t map_init = 0;

	if (!map_init) {

		// unmapped chars
		for (uint8_t i = 0; i < 26; i++) {
			map[i] = 63;
		}

		// SYMBOLS
		map[32] = 36; // space
		map[33] = 37; // !
		map[34] = 38; // "
		map[35] = 39; // #
		map[36] = 40; // $
		map[37] = 41; // %
		map[38] = 42; // &
		map[39] = 43; // '
		map[40] = 44; // (
		map[41] = 45; // )
		map[42] = 46; // *
		map[43] = 47; // +
		map[44] = 48; // ,
		map[45] = 49; // -
		map[46] = 50; // .
		map[47] = 51; // /
		map[58] = 52; // :
		map[59] = 53; // ;
		map[60] = 54; // <
		map[61] = 55; // =
		map[62] = 56; // >
		map[63] = 57; // ?
		map[91] = 58; // [
		map[92] = 59; /* \ */
		map[93] = 60; // ]
		map[94] = 61; // ^
		map[95] = 62; // _
		map[64] = 63; // @ special

		// NUMBERS
		for (uint8_t i = 0; i < 10; i++) {
			map[48 + i] = 26 + i;
		}

		// LETTERS
		for (uint8_t i = 0; i < 26; i++) {
			map[65 + i] = i; // uppercase
			map[97 + i] = i; // lowercase
		}

		map_init = 1;
	}

	return map[(uint8_t)c];
}

void LCD_Painter_DrawChar(char c, uint16_t x, uint16_t y, uint16_t color, uint16_t bg_color, enum Font font) {

	uint16_t selected = Translate(c);
	uint16_t fwidth = 0, fheight = 0;
	const uint8_t *font_x_y;

	if (font == SMALL) {
		fwidth = 8;
		fheight = 12;
		font_x_y = font_8_12;
	} else if (font == MEDIUM) {
		fwidth = 10;
		fheight = 16;
		font_x_y = font_10_16;
	} else if (font == LARGE) {
		fwidth = 12;
		fheight = 18;
		font_x_y = font_12_18;
	}

	uint16_t bit_offset = selected * fwidth * fheight;

	ILI9341_SetCursorPosition(x, y, fwidth+x-1, fheight+y-1);

	for (uint16_t _y = 0; _y < fheight; _y++) {
		for (uint16_t _x = 0; _x < fwidth; _x++) {
			uint16_t bit_index = _x + _y * fwidth;
			// print with background, copied from fill_rect
			if ((font_x_y[(bit_offset + bit_index) / 8] >> (7 - (bit_offset + bit_index) % 8)) & 0x01) {
				ILI9341_SendData(color>>8);
				ILI9341_SendData(color&0xff);
			} else {
				ILI9341_SendData(bg_color>>8);
				ILI9341_SendData(bg_color&0xff);
			}

		}
	}
}

/*

SMALL:
horizontally 40 chars
vertically 20 chars

MEDIUM
horizontally 32 chars
vertically 15 chars

LARGE
horizontally 26,7 chars
vertically 13,3 chars

 */

void LCD_Painter_DrawText(char text[], uint16_t x, uint16_t y, uint16_t color, uint16_t bg_color, enum Font font) {
	uint16_t i = 0;
	uint16_t fwidth = 0;
	if (font == SMALL) {
		fwidth = 8;
	} else if (font == MEDIUM) {
		fwidth = 10;
	} else if (font == LARGE) {
		fwidth = 12;
	}

	while(text[i] > 0) {
		LCD_Painter_DrawChar(text[i], x + fwidth * i, y, color, bg_color, font);
		i++;
	}
}

void LCD_Painter_EraseText(uint16_t chars, uint16_t x, uint16_t y, uint16_t bg_color, enum Font font) {

	uint16_t fwidth = 0, fheight = 0;

	if (font == SMALL) {
		fwidth = 8;
		fheight = 12;
	} else if (font == MEDIUM) {
		fwidth = 10;
		fheight = 16;
	} else if (font == LARGE) {
		fwidth = 12;
		fheight = 18;
	}

	ILI9341_Fill_Rect(x, y, x + chars * fwidth - 1, y + fheight - 1, bg_color);
}

